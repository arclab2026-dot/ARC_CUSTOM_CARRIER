/*
 * CAUTION: This file is automatically generated by Xilinx.
 * Version: XSCT 2022.2
 * Today is: Tue Oct 13 11:40:42 2026
 */


/ {
	amba_pl: amba_pl@0 {
		#address-cells = <2>;
		#size-cells = <2>;
		compatible = "simple-bus";
		ranges ;
		arc_ctrl_status_0: arc_ctrl_status@a0000000 {
			/* This is a place holder node for a custom IP, user may need to update the entries */
			clock-names = "s_axi_aclk";
			clocks = <&zynqmp_clk 71>;
			compatible = "xlnx,arc-ctrl-status-1.0";
			reg = <0x0 0xa0000000 0x0 0x10000>;
		};
	};
};
